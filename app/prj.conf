## prj.conf
```kconfig
CONFIG_GPIO=y
CONFIG_LOG=y

CONFIG_SHELL=y
CONFIG_ASSERT=y

CONFIG_BOOTLOADER_MCUBOOT=y
```

## boards/training.overlay
```dts
/ {
    aliases {
        led0 = &green_led;
    };

    zephyr,user {
        blink-period-ms = <2000>;
    };
};
```

## src/main.c
```c
#include <zephyr/drivers/gpio.h>
#include <zephyr/kernel.h>
#include <zephyr/logging/log.h>

#define LED_NODE DT_ALIAS(led0)
#define BLINK_MS DT_PROP(DT_PATH(zephyr_user), blink_period_ms)

static const struct gpio_dt_spec led = GPIO_DT_SPEC_GET(LED_NODE, gpios);

LOG_MODULE_REGISTER(main, LOG_LEVEL_INF);

int main(void) {
  bool led_state = true;

  if (!gpio_is_ready_dt(&led)) {
    return 0;
  }

  if (gpio_pin_configure_dt(&led, GPIO_OUTPUT_ACTIVE) < 0) {
    return 0;
  }

  while (true) {
    if (gpio_pin_toggle_dt(&led) < 0) {
      return 0;
    }

    led_state = !led_state;
    LOG_INF("LED state: %s", led_state ? "ON" : "OFF");
    k_msleep(BLINK_MS);
  }

  return 0;
}
```
